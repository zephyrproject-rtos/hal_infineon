# psc3m6 register map
Vendor: Infineon Technologies; Series: PSC3M6; File version: 1.0
CPU: CM33 r0p1, little endian, MPU, FPU, DSP, VTOR, 3 interrupt priority bits, 167 interrupts
Registers are 32-bit, read-write, reset 0x0 unless marked. A register's access mark holds for its fields unless they carry their own. Offsets are from the block's base; lines under a group give offsets from that group; [hi:lo] are bit positions; {n}, {i} and the like mark numbered series; 'fields as' and 'values as' point back to an identical list; <NAME> marks a mode.

## Memory map
0x42000000 PERI size 0x10000 — Peripheral interconnect
0x42020000 PPC size 0x10000 — Peripheral Protection Controller
0x42040000 PERI_PCLK size 0x20000 — Peripheral PCLK groups
0x42100000 RAMC_PPU0 size 0x1000 — Power Policy Unit Registers for System RAM
0x42101000 RAMC_PPU1 size 0x1000
0x42103000 ICACHE0 size 0x1000 — CM33_0/1 CA APB interface
0x42105000 CPUSS_PPU size 0x1000 — Power Policy Unit Registers for CPUSS
0x42110000 RAMC0 size 0x10000 — RAMC0/1/2
0x42120000 RAMC1 size 0x10000
0x42140000 PROMC size 0x10000 — Patchable ROM Controller
0x42150000 FLASHC size 0x10000
0x42160000 MXCM33 size 0x10000 — MXCM33-0/1
0x42180000 DW0 size 0x10000 — DW-0/1
0x42190000 DW1 size 0x10000
0x421C0000 CPUSS size 0x4000 — SYSCPUSS registers
0x421C4000 MS_CTL_2_1 size 0x4000 — Master control registers
0x421C8000 CPUSS_SL_CTL size 0x10 — SYSCPUSS Internal slave control registers
0x421D0000 IPC size 0x10000
0x421E0000 FAULT size 0x10000 — Fault structures
0x42200000 SRSS size 0x10000 — SRSS Core Registers
0x42210000 PWRMODE size 0x10000 — SRSS Power Mode Control Registers
0x42220000 BACKUP size 0x10000 — SRSS Backup Registers
0x42230000 CRYPTOLITE size 0x10000
0x42240000 MXCORDIC_1_1 size 0x10000
0x42250000 DEBUG600 size 0x100
0x42260000 SVGS size 0x100 — SVGS Registers
0x42270000 MXAES size 0x2000
0x42280000 MXWOUND size 0x1000 — 0
0x42400000 HSIOM size 0x4000 — IO Matrix (IOM)
0x42410000 GPIO size 0x10000 — IO port control/configuration
0x42420000 SMARTIO size 0x10000 — Programmable IO configuration
0x42430000 LPCOMP size 0x10000 — Low Power Comparators
0x42610000 EFUSE size 0x200 — EFUSE MXS40 registers
0x42800000 CANFD0 size 0x20000 — CAN Controller
0x42820000 SCB0 size 0x10000 — Serial Communications Block (SPI/UART/I2C)
0x42840000 SCB1 size 0x10000
0x42850000 SCB2 size 0x10000
0x42860000 SCB3 size 0x10000
0x42870000 SCB4 size 0x10000
0x42A00000 TCPWM0 size 0x100000 — S40 Timer/Counter/PWM
0x42B00000 HPPASS size 0x100000 — Top Level of MCPASS IP
0x42C00000 SCB5 size 0x10000
0x42C10000 I3C0 size 0x10000 — I3C controller top
0x42C20000 USBFS0 size 0x10000 — USB Host and Device Controller

## Interrupts
{n} ioss_interrupts_gpio_{n} (CPUSS) (n=0..13) — GPIO Port Interrupt #{n}
{n+14} ioss_interrupts_sec_gpio_{n} (CPUSS) (n=0..13) — GPIO Port Secure Interrupt #{n}
28 ioss_interrupt_vdd (CPUSS) — GPIO Supply Detect Interrupt
29 ioss_interrupt_gpio (CPUSS) — GPIO All Ports - Interrupts
30 ioss_interrupt_sec_gpio (CPUSS) — GPIO All Ports - Secure Interrupts
31 scb_0_interrupt (CPUSS) — Serial Communication Block #0 (DeepSleep capable)
32 srss_interrupt_mcwdt_0 (CPUSS) — Multi Counter Watchdog Timer interrupt
33 srss_interrupt_backup (CPUSS) — Backup domain interrupt
34 cpuss_interrupts_ipc_dpslp_0 (CPUSS) — cpuss Inter Process Communication Interrupt #0
35 cpuss_interrupts_ipc_dpslp_1 (CPUSS) — cpuss Inter Process Communication Interrupt #1
36 srss_interrupt_wdt (CPUSS) — Interrupt from WDT
37 lpcomp_interrupt (CPUSS) — LPCOMP
38 srss_interrupt (CPUSS) — Other combined Interrupts for srss (LVD and CLKCAL, CLKCAL only supported in Active mode)
39 scb_1_interrupt (CPUSS) — Serial Communication Block #1
40 scb_2_interrupt (CPUSS) — Serial Communication Block #2
41 scb_3_interrupt (CPUSS) — Serial Communication Block #3
42 scb_4_interrupt (CPUSS) — Serial Communication Block #4
43 scb_5_interrupt (CPUSS) — Serial Communication Block #5
44 i3c_0_interrupt (CPUSS) — I3C #0
45 cpuss_interrupt_fm_cbus (CPUSS) — FLASH Macro interrupt
{n+46} cpuss_interrupts_dw0_{n} (CPUSS) (n=0..15) — cpuss DataWire #0, Channel #{n}
{n+62} cpuss_interrupts_dw1_{n} (CPUSS) (n=0..15) — cpuss DataWire #1, Channel #{n}
78 cpuss_interrupt_ppu_sramc0 (CPUSS) — PPU SRAM0
79 cpuss_interrupt_ppu_sramc1 (CPUSS) — PPU SRAM1
80 cpuss_interrupt_cm33_0_fp (CPUSS) — CM33 0 Floating Point Interrupt
81 cpuss_interrupts_cm33_0_cti_0 (CPUSS) — CM33-0 CTI interrupt outputs
82 cpuss_interrupts_cm33_0_cti_1 (CPUSS) — CM33-1 CTI interrupt outputs
83 cpuss_interrupts_fault_0 (CPUSS) — cpuss Faults interrupt
84 cpuss_interrupt_ppu_cpuss (CPUSS) — cpuss PPU Interrupt
85 cpuss_interrupt_msc (CPUSS) — cpuss Master Security Controller Interrupt
{n+86} tcpwm_0_interrupts_{n} (CPUSS) (n=0..7) — TCPWM #0, Counter #{n}
{n-162} tcpwm_0_interrupts_{n} (CPUSS) (n=256..263) — TCPWM #0, Counter #{n}
{n-410} tcpwm_0_interrupts_{n} (CPUSS) (n=512..519) — TCPWM #0, Counter #{n}
110 srss_interrupt_main_ppu (CPUSS) — SRSS Main PPU Interrupt
111 cryptolite_interrupt_error (CPUSS) — Crypto Interrupt
112 cryptolite_interrupt_trng (CPUSS) — Crypto TRNG interrupt
113 canfd_0_interrupts0_0 (CPUSS) — CAN #0, Interrupt #0, Channel #0
114 canfd_0_interrupts1_0 (CPUSS) — CAN #0, Interrupt #1, Channel #0
115 canfd_0_interrupts0_1 (CPUSS) — CAN #0, Interrupt #0, Channel #1
116 canfd_0_interrupts1_1 (CPUSS) — CAN #0, Interrupt #1, Channel #1
117 canfd_0_interrupt0 (CPUSS) — Can #0, Consolidated interrupt #0
118 canfd_0_interrupt1 (CPUSS) — Can #0, Consolidated interrupt #1
119 cordic_interrupt_mxcordic (CPUSS) — CORDIC
120 tcpwm_0_motif_interrupt_64 (CPUSS) — TCPWM #0, MOTIF #1, GRP#1 SR0
121 tcpwm_0_motif_interrupt_65 (CPUSS) — TCPWM #0, MOTIF #1, GRP#1 SR1
122 tcpwm_0_motif_interrupt_128 (CPUSS) — TCPWM #0, MOTIF #1, GRP#2 SR0
123 tcpwm_0_motif_interrupt_129 (CPUSS) — TCPWM #0, MOTIF #1, GRP#2 SR1
124 pass_interrupt_mcpass (CPUSS) — Combined MCPASS interrupt, AC, Error conditions
125 pass_interrupt_sar_results (CPUSS) — Combined SAR Entry and FIR results interrupt
{n+126} pass_interrupt_sar_entry_done_{n} (CPUSS) (n=0..7) — Individual SAR Entry result interrupt[{n}]
134 pass_interrupt_sar_fir_done_0 (CPUSS) — Individual FIR result interrupts[0]
135 pass_interrupt_sar_fir_done_1 (CPUSS) — Individual FIR result interrupts[1]
136 pass_interrupt_sar_ranges (CPUSS) — Combined SAR range interrupt
{n+137} pass_interrupt_sar_range_{n} (CPUSS) (n=0..7) — Individual SAR range interrupt[{n}]
145 pass_interrupt_csg_dacs (CPUSS) — Combined CSG DAC interrupt
{n+146} pass_interrupt_csg_dac_{n} (CPUSS) (n=0..8) — Individual CSG DAC interrupt[{n}]
155 pass_interrupt_csg_cmps (CPUSS) — Combined CSG CMP interrupts
156 pass_interrupt_fifos (CPUSS) — Combined FIFO interrupts
157 pass_interrupt_hwfilt3p3z_done_0 (CPUSS) — Individual 3P3Z result interrupt[0]
158 pass_interrupt_hwfilt3p3z_done_1 (CPUSS) — Individual 3P3Z result interrupt[1]
159 pass_interrupt_hwfilt3p3z_done_2 (CPUSS) — Individual 3P3Z result interrupt[2]
160 pass_interrupt_dac_buffer_0 (CPUSS) — Individual DAC buffer interrupt[0]
161 pass_interrupt_dac_buffer_1 (CPUSS) — Individual DAC buffer interrupt[1]
162 svgs_interrupt (CPUSS)
163 mxaes_mxaes_level_int (CPUSS) — MXAES
164 usb_0_interrupt_hi (CPUSS) — USBFS HI
165 usb_0_interrupt_med (CPUSS) — USBFS MED
166 usb_0_interrupt_lo (CPUSS) — USBFS LOW

## Licence text in the file
(c) 2016-2026, Infineon Technologies AG or an affiliate of. Infineon Technologies AG. SPDX-License-Identifier: Apache-2.0 . Licensed under the Apache License, Version 2.0 (the "License"); you may not use this file except in compliance with the License. You may obtain a copy of the License at http://www.apache.org/licenses/LICENSE-2.0 . Unless required by applicable law or agreed to in writing, software distributed under the License is distributed on an "AS IS" BASIS, WITHOUT WARRANTIES OR CONDITIONS OF ANY KIND, either express or implied. See the License for the specific language governing permissions and limitations under the License.

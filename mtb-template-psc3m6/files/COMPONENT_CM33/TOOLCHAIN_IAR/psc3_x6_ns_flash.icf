/*******************************************************************************
* \file psc3xxf_ns_flash.icf
* \version 1.000
*
* Linker file for the IAR compiler.
*
* The main purpose of the linker script is to describe how the sections in the
* input files should be mapped into the output file, and to control the memory
* layout of the output file.
*
* \note The entry point is fixed and starts at 0x02010000. The valid application
* image should be placed there.
*
* \note The linker files included with the PDL template projects must be generic
* and handle all common use cases. Your project may not use every section
* defined in the linker files. In that case you may see warnings during the
* build process. In your project, you can simply comment out or remove the
* relevant code in the linker file.
*
********************************************************************************
* \copyright
* (c) 2026, Infineon Technologies AG, or an affiliate of Infineon
* Technologies AG.
* SPDX-License-Identifier: Apache-2.0
*
* Licensed under the Apache License, Version 2.0 (the "License");
* you may not use this file except in compliance with the License.
* You may obtain a copy of the License at
*
*     http://www.apache.org/licenses/LICENSE-2.0
*
* Unless required by applicable law or agreed to in writing, software
* distributed under the License is distributed on an "AS IS" BASIS,
* WITHOUT WARRANTIES OR CONDITIONS OF ANY KIND, either express or implied.
* See the License for the specific language governing permissions and
* limitations under the License.
*******************************************************************************/

/* Include the device memory definitions generated by the Device Configurator */
include  "../config/GeneratedSource/cymem_ilinkarm_CM33_0.icf";

/*-Sizes-*/
if (!isdefinedsymbol(__STACK_SIZE)) {
  define symbol __ICFEDIT_size_cstack__ = 0x1000;
} else {
  define symbol __ICFEDIT_size_cstack__ = __STACK_SIZE;
}
define symbol __ICFEDIT_size_proc_stack__ = 0x0;

/* Defines the minimum heap size. The actual heap size will be expanded to the end of the stack region */
if (!isdefinedsymbol(__HEAP_SIZE)) {
    define symbol __ICFEDIT_size_heap__ = 0x0400;
} else {
  define symbol __ICFEDIT_size_heap__ = __HEAP_SIZE;
}
/**** End of ICF editor section. ###ICF###*/

/* Include the memory regions generated by the Device Configurator.
  This file contains the memory region definitions for the device,
  which are used to define the memory layout in this linker script. */
include  "../config/GeneratedSource/cymem_ilinkarm_regions_CM33_0.icf";

/* MCUBoot header size - space reserved at the beginning of flash for MCUBoot header.
 * Default is 0 (no header). Override via --config_def=MCUBOOT_HEADER_SIZE=<size> when using MCUBoot. */
if (!isdefinedsymbol(MCUBOOT_HEADER_SIZE)) {
    define symbol MCUBOOT_HEADER_SIZE = 0x0;
}

/* Note: Code is placed at C-bus addresses (e.g. 0x02000000 for non-secure).
 * No S-bus relocation (logical/physical mapping) is performed by the linker.
 * Any required S-bus relocation (e.g. for flash programming) is handled
 * uniformly in a post-build step.
 */

define block CSTACK     with alignment = 8, size = __ICFEDIT_size_cstack__     { };
define block PROC_STACK with alignment = 8, size = __ICFEDIT_size_proc_stack__ { };
define block HEAP       with expanding size, alignment = 8, minimum size = __ICFEDIT_size_heap__ { };
define block HSTACK {block HEAP, block PROC_STACK, last block CSTACK};
define block RO     {first section .intvec, readonly};

/*-Initializations-*/
initialize by copy { readwrite };
do not initialize  { section .noinit, section .intvec_ram };

/*-Placement-*/

/* Flash - Cortex-M33 application */
place at address (CYMEM_CM33_0_m33ns_nvm_C_START + MCUBOOT_HEADER_SIZE) { block RO };

/* RAM */
place at start of m33ns_data  { readwrite section .intvec_ram};
place in          m33ns_data  { readwrite };
place at end   of m33ns_data  { block HSTACK };

place in          m33ns_shm_data { readwrite section .cy_sharedmem };

keep {  section .intvec  };

/* EOF */

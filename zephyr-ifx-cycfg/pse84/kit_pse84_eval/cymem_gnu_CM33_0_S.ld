/* This file is automatically generated. */

CYMEM_CM33_0_S_m55_data_START = 0x48040000;
CYMEM_CM33_0_S_m55_data_S_START = 0x58040000;
CYMEM_CM33_0_S_m55_data_SIZE = 0x00040000;
CYMEM_CM33_0_S_m55_data_OFFSET = 0x00000000;
CYMEM_CM33_0_S_m55_code_START = 0x48000000;
CYMEM_CM33_0_S_m55_code_S_START = 0x58000000;
CYMEM_CM33_0_S_m55_code_SIZE = 0x00040000;
CYMEM_CM33_0_S_m55_code_OFFSET = 0x00000000;
CYMEM_CM33_0_S_bootloader_nvm_START = 0x22011000;
CYMEM_CM33_0_S_bootloader_nvm_C_START = 0x02011000;
CYMEM_CM33_0_S_bootloader_nvm_C_S_START = 0x12011000;
CYMEM_CM33_0_S_bootloader_nvm_S_START = 0x32011000;
CYMEM_CM33_0_S_bootloader_nvm_SIZE = 0x00028000;
CYMEM_CM33_0_S_bootloader_nvm_OFFSET = 0x00011000;
CYMEM_CM33_0_S_user_nvm_START = 0x22039000;
CYMEM_CM33_0_S_user_nvm_C_START = 0x02039000;
CYMEM_CM33_0_S_user_nvm_C_S_START = 0x12039000;
CYMEM_CM33_0_S_user_nvm_S_START = 0x32039000;
CYMEM_CM33_0_S_user_nvm_SIZE = 0x0002A000;
CYMEM_CM33_0_S_user_nvm_OFFSET = 0x00039000;
CYMEM_CM33_0_S_TFM_ITS_START = 0x22063000;
CYMEM_CM33_0_S_TFM_ITS_C_START = 0x02063000;
CYMEM_CM33_0_S_TFM_ITS_C_S_START = 0x12063000;
CYMEM_CM33_0_S_TFM_ITS_S_START = 0x32063000;
CYMEM_CM33_0_S_TFM_ITS_SIZE = 0x00002000;
CYMEM_CM33_0_S_TFM_ITS_OFFSET = 0x00063000;
CYMEM_CM33_0_S_TFM_PS_START = 0x22065000;
CYMEM_CM33_0_S_TFM_PS_C_START = 0x02065000;
CYMEM_CM33_0_S_TFM_PS_C_S_START = 0x12065000;
CYMEM_CM33_0_S_TFM_PS_S_START = 0x32065000;
CYMEM_CM33_0_S_TFM_PS_SIZE = 0x00004000;
CYMEM_CM33_0_S_TFM_PS_OFFSET = 0x00065000;
CYMEM_CM33_0_S_TFM_NV_COUNTERS_START = 0x22069000;
CYMEM_CM33_0_S_TFM_NV_COUNTERS_C_START = 0x02069000;
CYMEM_CM33_0_S_TFM_NV_COUNTERS_C_S_START = 0x12069000;
CYMEM_CM33_0_S_TFM_NV_COUNTERS_S_START = 0x32069000;
CYMEM_CM33_0_S_TFM_NV_COUNTERS_SIZE = 0x00001000;
CYMEM_CM33_0_S_TFM_NV_COUNTERS_OFFSET = 0x00069000;
CYMEM_CM33_0_S_m33s_nvm_START = 0x60100000;
CYMEM_CM33_0_S_m33s_nvm_C_START = 0x08100000;
CYMEM_CM33_0_S_m33s_nvm_C_S_START = 0x18100000;
CYMEM_CM33_0_S_m33s_nvm_S_START = 0x70100000;
CYMEM_CM33_0_S_m33s_nvm_SIZE = 0x00200000;
CYMEM_CM33_0_S_m33s_nvm_OFFSET = 0x00100000;
CYMEM_CM33_0_S_m33s_trailer_START = 0x60300000;
CYMEM_CM33_0_S_m33s_trailer_C_START = 0x08300000;
CYMEM_CM33_0_S_m33s_trailer_C_S_START = 0x18300000;
CYMEM_CM33_0_S_m33s_trailer_S_START = 0x70300000;
CYMEM_CM33_0_S_m33s_trailer_SIZE = 0x00040000;
CYMEM_CM33_0_S_m33s_trailer_OFFSET = 0x00300000;
CYMEM_CM33_0_S_m33_nvm_START = 0x60340000;
CYMEM_CM33_0_S_m33_nvm_C_START = 0x08340000;
CYMEM_CM33_0_S_m33_nvm_C_S_START = 0x18340000;
CYMEM_CM33_0_S_m33_nvm_S_START = 0x70340000;
CYMEM_CM33_0_S_m33_nvm_SIZE = 0x00200000;
CYMEM_CM33_0_S_m33_nvm_OFFSET = 0x00340000;
CYMEM_CM33_0_S_m33_trailer_START = 0x60540000;
CYMEM_CM33_0_S_m33_trailer_C_START = 0x08540000;
CYMEM_CM33_0_S_m33_trailer_C_S_START = 0x18540000;
CYMEM_CM33_0_S_m33_trailer_S_START = 0x70540000;
CYMEM_CM33_0_S_m33_trailer_SIZE = 0x00040000;
CYMEM_CM33_0_S_m33_trailer_OFFSET = 0x00540000;
CYMEM_CM33_0_S_m55_nvm_START = 0x60580000;
CYMEM_CM33_0_S_m55_nvm_C_START = 0x08580000;
CYMEM_CM33_0_S_m55_nvm_C_S_START = 0x18580000;
CYMEM_CM33_0_S_m55_nvm_S_START = 0x70580000;
CYMEM_CM33_0_S_m55_nvm_SIZE = 0x002C0000;
CYMEM_CM33_0_S_m55_nvm_OFFSET = 0x00580000;
CYMEM_CM33_0_S_m55_trailer_START = 0x60840000;
CYMEM_CM33_0_S_m55_trailer_C_START = 0x08840000;
CYMEM_CM33_0_S_m55_trailer_C_S_START = 0x18840000;
CYMEM_CM33_0_S_m55_trailer_S_START = 0x70840000;
CYMEM_CM33_0_S_m55_trailer_SIZE = 0x00040000;
CYMEM_CM33_0_S_m55_trailer_OFFSET = 0x00840000;
CYMEM_CM33_0_S_m33s_upgrade_slot_START = 0x60880000;
CYMEM_CM33_0_S_m33s_upgrade_slot_C_START = 0x08880000;
CYMEM_CM33_0_S_m33s_upgrade_slot_C_S_START = 0x18880000;
CYMEM_CM33_0_S_m33s_upgrade_slot_S_START = 0x70880000;
CYMEM_CM33_0_S_m33s_upgrade_slot_SIZE = 0x00240000;
CYMEM_CM33_0_S_m33s_upgrade_slot_OFFSET = 0x00880000;
CYMEM_CM33_0_S_m33_upgrade_slot_START = 0x60AC0000;
CYMEM_CM33_0_S_m33_upgrade_slot_C_START = 0x08AC0000;
CYMEM_CM33_0_S_m33_upgrade_slot_C_S_START = 0x18AC0000;
CYMEM_CM33_0_S_m33_upgrade_slot_S_START = 0x70AC0000;
CYMEM_CM33_0_S_m33_upgrade_slot_SIZE = 0x00240000;
CYMEM_CM33_0_S_m33_upgrade_slot_OFFSET = 0x00AC0000;
CYMEM_CM33_0_S_m55_upgrade_slot_START = 0x60D00000;
CYMEM_CM33_0_S_m55_upgrade_slot_C_START = 0x08D00000;
CYMEM_CM33_0_S_m55_upgrade_slot_C_S_START = 0x18D00000;
CYMEM_CM33_0_S_m55_upgrade_slot_S_START = 0x70D00000;
CYMEM_CM33_0_S_m55_upgrade_slot_SIZE = 0x00300000;
CYMEM_CM33_0_S_m55_upgrade_slot_OFFSET = 0x00D00000;
CYMEM_CM33_0_S_m55_code_secondary_START = 0x26000000;
CYMEM_CM33_0_S_m55_code_secondary_C_START = 0x06000000;
CYMEM_CM33_0_S_m55_code_secondary_C_S_START = 0x16000000;
CYMEM_CM33_0_S_m55_code_secondary_S_START = 0x36000000;
CYMEM_CM33_0_S_m55_code_secondary_SIZE = 0x00040000;
CYMEM_CM33_0_S_m55_code_secondary_OFFSET = 0x00000000;
CYMEM_CM33_0_S_m55_data_secondary_START = 0x26040000;
CYMEM_CM33_0_S_m55_data_secondary_C_START = 0x06040000;
CYMEM_CM33_0_S_m55_data_secondary_C_S_START = 0x16040000;
CYMEM_CM33_0_S_m55_data_secondary_S_START = 0x36040000;
CYMEM_CM33_0_S_m55_data_secondary_SIZE = 0x002BC000;
CYMEM_CM33_0_S_m55_data_secondary_OFFSET = 0x00040000;
CYMEM_CM33_0_S_m33_m55_shared_START = 0x262FC000;
CYMEM_CM33_0_S_m33_m55_shared_C_START = 0x062FC000;
CYMEM_CM33_0_S_m33_m55_shared_C_S_START = 0x162FC000;
CYMEM_CM33_0_S_m33_m55_shared_S_START = 0x362FC000;
CYMEM_CM33_0_S_m33_m55_shared_SIZE = 0x00040000;
CYMEM_CM33_0_S_m33_m55_shared_OFFSET = 0x002FC000;
CYMEM_CM33_0_S_gfx_mem_START = 0x2633C000;
CYMEM_CM33_0_S_gfx_mem_C_START = 0x0633C000;
CYMEM_CM33_0_S_gfx_mem_C_S_START = 0x1633C000;
CYMEM_CM33_0_S_gfx_mem_S_START = 0x3633C000;
CYMEM_CM33_0_S_gfx_mem_SIZE = 0x001C4000;
CYMEM_CM33_0_S_gfx_mem_OFFSET = 0x0033C000;
CYMEM_CM33_0_S_m33s_shared_START = 0x24001000;
CYMEM_CM33_0_S_m33s_shared_C_START = 0x04001000;
CYMEM_CM33_0_S_m33s_shared_C_S_START = 0x14001000;
CYMEM_CM33_0_S_m33s_shared_S_START = 0x34001000;
CYMEM_CM33_0_S_m33s_shared_SIZE = 0x00001000;
CYMEM_CM33_0_S_m33s_shared_OFFSET = 0x00001000;
CYMEM_CM33_0_S_m33s_data_START = 0x24037000;
CYMEM_CM33_0_S_m33s_data_C_START = 0x04037000;
CYMEM_CM33_0_S_m33s_data_C_S_START = 0x14037000;
CYMEM_CM33_0_S_m33s_data_S_START = 0x34037000;
CYMEM_CM33_0_S_m33s_data_SIZE = 0x00021000;
CYMEM_CM33_0_S_m33s_data_OFFSET = 0x00037000;
CYMEM_CM33_0_S_m33_code_START = 0x24058000;
CYMEM_CM33_0_S_m33_code_C_START = 0x04058000;
CYMEM_CM33_0_S_m33_code_C_S_START = 0x14058000;
CYMEM_CM33_0_S_m33_code_S_START = 0x34058000;
CYMEM_CM33_0_S_m33_code_SIZE = 0x00065000;
CYMEM_CM33_0_S_m33_code_OFFSET = 0x00058000;
CYMEM_CM33_0_S_m33_data_START = 0x240BD000;
CYMEM_CM33_0_S_m33_data_C_START = 0x040BD000;
CYMEM_CM33_0_S_m33_data_C_S_START = 0x140BD000;
CYMEM_CM33_0_S_m33_data_S_START = 0x340BD000;
CYMEM_CM33_0_S_m33_data_SIZE = 0x00040000;
CYMEM_CM33_0_S_m33_data_OFFSET = 0x000BD000;
CYMEM_CM33_0_S_m33s_allocatable_shared_START = 0x240FD000;
CYMEM_CM33_0_S_m33s_allocatable_shared_C_START = 0x040FD000;
CYMEM_CM33_0_S_m33s_allocatable_shared_C_S_START = 0x140FD000;
CYMEM_CM33_0_S_m33s_allocatable_shared_S_START = 0x340FD000;
CYMEM_CM33_0_S_m33s_allocatable_shared_SIZE = 0x00001000;
CYMEM_CM33_0_S_m33s_allocatable_shared_OFFSET = 0x000FD000;
CYMEM_CM33_0_S_m33_allocatable_shared_START = 0x240FE000;
CYMEM_CM33_0_S_m33_allocatable_shared_C_START = 0x040FE000;
CYMEM_CM33_0_S_m33_allocatable_shared_C_S_START = 0x140FE000;
CYMEM_CM33_0_S_m33_allocatable_shared_S_START = 0x340FE000;
CYMEM_CM33_0_S_m33_allocatable_shared_SIZE = 0x00001000;
CYMEM_CM33_0_S_m33_allocatable_shared_OFFSET = 0x000FE000;
CYMEM_CM33_0_S_m55_allocatable_shared_START = 0x240FF000;
CYMEM_CM33_0_S_m55_allocatable_shared_C_START = 0x040FF000;
CYMEM_CM33_0_S_m55_allocatable_shared_C_S_START = 0x140FF000;
CYMEM_CM33_0_S_m55_allocatable_shared_S_START = 0x340FF000;
CYMEM_CM33_0_S_m55_allocatable_shared_SIZE = 0x00001000;
CYMEM_CM33_0_S_m55_allocatable_shared_OFFSET = 0x000FF000;

MEMORY
{
    m55_data : ORIGIN = 0x48040000, LENGTH = 0x00040000
    m55_data_S : ORIGIN = 0x58040000, LENGTH = 0x00040000
    m55_code : ORIGIN = 0x48000000, LENGTH = 0x00040000
    m55_code_S : ORIGIN = 0x58000000, LENGTH = 0x00040000
    bootloader_nvm : ORIGIN = 0x22011000, LENGTH = 0x00028000
    bootloader_nvm_C : ORIGIN = 0x02011000, LENGTH = 0x00028000
    bootloader_nvm_C_S : ORIGIN = 0x12011000, LENGTH = 0x00028000
    bootloader_nvm_S : ORIGIN = 0x32011000, LENGTH = 0x00028000
    user_nvm : ORIGIN = 0x22039000, LENGTH = 0x0002A000
    user_nvm_C : ORIGIN = 0x02039000, LENGTH = 0x0002A000
    user_nvm_C_S : ORIGIN = 0x12039000, LENGTH = 0x0002A000
    user_nvm_S : ORIGIN = 0x32039000, LENGTH = 0x0002A000
    TFM_ITS : ORIGIN = 0x22063000, LENGTH = 0x00002000
    TFM_ITS_C : ORIGIN = 0x02063000, LENGTH = 0x00002000
    TFM_ITS_C_S : ORIGIN = 0x12063000, LENGTH = 0x00002000
    TFM_ITS_S : ORIGIN = 0x32063000, LENGTH = 0x00002000
    TFM_PS : ORIGIN = 0x22065000, LENGTH = 0x00004000
    TFM_PS_C : ORIGIN = 0x02065000, LENGTH = 0x00004000
    TFM_PS_C_S : ORIGIN = 0x12065000, LENGTH = 0x00004000
    TFM_PS_S : ORIGIN = 0x32065000, LENGTH = 0x00004000
    TFM_NV_COUNTERS : ORIGIN = 0x22069000, LENGTH = 0x00001000
    TFM_NV_COUNTERS_C : ORIGIN = 0x02069000, LENGTH = 0x00001000
    TFM_NV_COUNTERS_C_S : ORIGIN = 0x12069000, LENGTH = 0x00001000
    TFM_NV_COUNTERS_S : ORIGIN = 0x32069000, LENGTH = 0x00001000
    m33s_nvm : ORIGIN = 0x60100000, LENGTH = 0x00200000
    m33s_nvm_C : ORIGIN = 0x08100000, LENGTH = 0x00200000
    m33s_nvm_C_S : ORIGIN = 0x18100000, LENGTH = 0x00200000
    m33s_nvm_S : ORIGIN = 0x70100000, LENGTH = 0x00200000
    m33s_trailer : ORIGIN = 0x60300000, LENGTH = 0x00040000
    m33s_trailer_C : ORIGIN = 0x08300000, LENGTH = 0x00040000
    m33s_trailer_C_S : ORIGIN = 0x18300000, LENGTH = 0x00040000
    m33s_trailer_S : ORIGIN = 0x70300000, LENGTH = 0x00040000
    m33_nvm : ORIGIN = 0x60340000, LENGTH = 0x00200000
    m33_nvm_C : ORIGIN = 0x08340000, LENGTH = 0x00200000
    m33_nvm_C_S : ORIGIN = 0x18340000, LENGTH = 0x00200000
    m33_nvm_S : ORIGIN = 0x70340000, LENGTH = 0x00200000
    m33_trailer : ORIGIN = 0x60540000, LENGTH = 0x00040000
    m33_trailer_C : ORIGIN = 0x08540000, LENGTH = 0x00040000
    m33_trailer_C_S : ORIGIN = 0x18540000, LENGTH = 0x00040000
    m33_trailer_S : ORIGIN = 0x70540000, LENGTH = 0x00040000
    m55_nvm : ORIGIN = 0x60580000, LENGTH = 0x002C0000
    m55_nvm_C : ORIGIN = 0x08580000, LENGTH = 0x002C0000
    m55_nvm_C_S : ORIGIN = 0x18580000, LENGTH = 0x002C0000
    m55_nvm_S : ORIGIN = 0x70580000, LENGTH = 0x002C0000
    m55_trailer : ORIGIN = 0x60840000, LENGTH = 0x00040000
    m55_trailer_C : ORIGIN = 0x08840000, LENGTH = 0x00040000
    m55_trailer_C_S : ORIGIN = 0x18840000, LENGTH = 0x00040000
    m55_trailer_S : ORIGIN = 0x70840000, LENGTH = 0x00040000
    m33s_upgrade_slot : ORIGIN = 0x60880000, LENGTH = 0x00240000
    m33s_upgrade_slot_C : ORIGIN = 0x08880000, LENGTH = 0x00240000
    m33s_upgrade_slot_C_S : ORIGIN = 0x18880000, LENGTH = 0x00240000
    m33s_upgrade_slot_S : ORIGIN = 0x70880000, LENGTH = 0x00240000
    m33_upgrade_slot : ORIGIN = 0x60AC0000, LENGTH = 0x00240000
    m33_upgrade_slot_C : ORIGIN = 0x08AC0000, LENGTH = 0x00240000
    m33_upgrade_slot_C_S : ORIGIN = 0x18AC0000, LENGTH = 0x00240000
    m33_upgrade_slot_S : ORIGIN = 0x70AC0000, LENGTH = 0x00240000
    m55_upgrade_slot : ORIGIN = 0x60D00000, LENGTH = 0x00300000
    m55_upgrade_slot_C : ORIGIN = 0x08D00000, LENGTH = 0x00300000
    m55_upgrade_slot_C_S : ORIGIN = 0x18D00000, LENGTH = 0x00300000
    m55_upgrade_slot_S : ORIGIN = 0x70D00000, LENGTH = 0x00300000
    m55_code_secondary : ORIGIN = 0x26000000, LENGTH = 0x00040000
    m55_code_secondary_C : ORIGIN = 0x06000000, LENGTH = 0x00040000
    m55_code_secondary_C_S : ORIGIN = 0x16000000, LENGTH = 0x00040000
    m55_code_secondary_S : ORIGIN = 0x36000000, LENGTH = 0x00040000
    m55_data_secondary : ORIGIN = 0x26040000, LENGTH = 0x002BC000
    m55_data_secondary_C : ORIGIN = 0x06040000, LENGTH = 0x002BC000
    m55_data_secondary_C_S : ORIGIN = 0x16040000, LENGTH = 0x002BC000
    m55_data_secondary_S : ORIGIN = 0x36040000, LENGTH = 0x002BC000
    m33_m55_shared : ORIGIN = 0x262FC000, LENGTH = 0x00040000
    m33_m55_shared_C : ORIGIN = 0x062FC000, LENGTH = 0x00040000
    m33_m55_shared_C_S : ORIGIN = 0x162FC000, LENGTH = 0x00040000
    m33_m55_shared_S : ORIGIN = 0x362FC000, LENGTH = 0x00040000
    gfx_mem : ORIGIN = 0x2633C000, LENGTH = 0x001C4000
    gfx_mem_C : ORIGIN = 0x0633C000, LENGTH = 0x001C4000
    gfx_mem_C_S : ORIGIN = 0x1633C000, LENGTH = 0x001C4000
    gfx_mem_S : ORIGIN = 0x3633C000, LENGTH = 0x001C4000
    m33s_shared : ORIGIN = 0x24001000, LENGTH = 0x00001000
    m33s_shared_C : ORIGIN = 0x04001000, LENGTH = 0x00001000
    m33s_shared_C_S : ORIGIN = 0x14001000, LENGTH = 0x00001000
    m33s_shared_S : ORIGIN = 0x34001000, LENGTH = 0x00001000
    m33s_data : ORIGIN = 0x24037000, LENGTH = 0x00021000
    m33s_data_C : ORIGIN = 0x04037000, LENGTH = 0x00021000
    m33s_data_C_S : ORIGIN = 0x14037000, LENGTH = 0x00021000
    m33s_data_S : ORIGIN = 0x34037000, LENGTH = 0x00021000
    m33_code : ORIGIN = 0x24058000, LENGTH = 0x00065000
    m33_code_C : ORIGIN = 0x04058000, LENGTH = 0x00065000
    m33_code_C_S : ORIGIN = 0x14058000, LENGTH = 0x00065000
    m33_code_S : ORIGIN = 0x34058000, LENGTH = 0x00065000
    m33_data : ORIGIN = 0x240BD000, LENGTH = 0x00040000
    m33_data_C : ORIGIN = 0x040BD000, LENGTH = 0x00040000
    m33_data_C_S : ORIGIN = 0x140BD000, LENGTH = 0x00040000
    m33_data_S : ORIGIN = 0x340BD000, LENGTH = 0x00040000
    m33s_allocatable_shared : ORIGIN = 0x240FD000, LENGTH = 0x00001000
    m33s_allocatable_shared_C : ORIGIN = 0x040FD000, LENGTH = 0x00001000
    m33s_allocatable_shared_C_S : ORIGIN = 0x140FD000, LENGTH = 0x00001000
    m33s_allocatable_shared_S : ORIGIN = 0x340FD000, LENGTH = 0x00001000
    m33_allocatable_shared : ORIGIN = 0x240FE000, LENGTH = 0x00001000
    m33_allocatable_shared_C : ORIGIN = 0x040FE000, LENGTH = 0x00001000
    m33_allocatable_shared_C_S : ORIGIN = 0x140FE000, LENGTH = 0x00001000
    m33_allocatable_shared_S : ORIGIN = 0x340FE000, LENGTH = 0x00001000
    m55_allocatable_shared : ORIGIN = 0x240FF000, LENGTH = 0x00001000
    m55_allocatable_shared_C : ORIGIN = 0x040FF000, LENGTH = 0x00001000
    m55_allocatable_shared_C_S : ORIGIN = 0x140FF000, LENGTH = 0x00001000
    m55_allocatable_shared_S : ORIGIN = 0x340FF000, LENGTH = 0x00001000
}

REGION_ALIAS("m55_data_sel", m55_data)
REGION_ALIAS("m55_data_sel_S", m55_data_S)
REGION_ALIAS("m55_code_sel", m55_code)
REGION_ALIAS("m55_code_sel_S", m55_code_S)
REGION_ALIAS("bootloader_nvm_sel", bootloader_nvm_C)
REGION_ALIAS("bootloader_nvm_sel_S", bootloader_nvm_C_S)
REGION_ALIAS("user_nvm_sel", user_nvm_C)
REGION_ALIAS("user_nvm_sel_S", user_nvm_C_S)
REGION_ALIAS("TFM_ITS_sel", TFM_ITS_C)
REGION_ALIAS("TFM_ITS_sel_S", TFM_ITS_C_S)
REGION_ALIAS("TFM_PS_sel", TFM_PS_C)
REGION_ALIAS("TFM_PS_sel_S", TFM_PS_C_S)
REGION_ALIAS("TFM_NV_COUNTERS_sel", TFM_NV_COUNTERS_C)
REGION_ALIAS("TFM_NV_COUNTERS_sel_S", TFM_NV_COUNTERS_C_S)
REGION_ALIAS("m33s_nvm_sel", m33s_nvm_C)
REGION_ALIAS("m33s_nvm_sel_S", m33s_nvm_C_S)
REGION_ALIAS("m33s_trailer_sel", m33s_trailer_C)
REGION_ALIAS("m33s_trailer_sel_S", m33s_trailer_C_S)
REGION_ALIAS("m33_nvm_sel", m33_nvm_C)
REGION_ALIAS("m33_nvm_sel_S", m33_nvm_C_S)
REGION_ALIAS("m33_trailer_sel", m33_trailer_C)
REGION_ALIAS("m33_trailer_sel_S", m33_trailer_C_S)
REGION_ALIAS("m55_nvm_sel", m55_nvm_C)
REGION_ALIAS("m55_nvm_sel_S", m55_nvm_C_S)
REGION_ALIAS("m55_trailer_sel", m55_trailer_C)
REGION_ALIAS("m55_trailer_sel_S", m55_trailer_C_S)
REGION_ALIAS("m33s_upgrade_slot_sel", m33s_upgrade_slot_C)
REGION_ALIAS("m33s_upgrade_slot_sel_S", m33s_upgrade_slot_C_S)
REGION_ALIAS("m33_upgrade_slot_sel", m33_upgrade_slot_C)
REGION_ALIAS("m33_upgrade_slot_sel_S", m33_upgrade_slot_C_S)
REGION_ALIAS("m55_upgrade_slot_sel", m55_upgrade_slot_C)
REGION_ALIAS("m55_upgrade_slot_sel_S", m55_upgrade_slot_C_S)
REGION_ALIAS("m55_code_secondary_sel", m55_code_secondary_C)
REGION_ALIAS("m55_code_secondary_sel_S", m55_code_secondary_C_S)
REGION_ALIAS("m55_data_secondary_sel", m55_data_secondary_C)
REGION_ALIAS("m55_data_secondary_sel_S", m55_data_secondary_C_S)
REGION_ALIAS("m33_m55_shared_sel", m33_m55_shared_C)
REGION_ALIAS("m33_m55_shared_sel_S", m33_m55_shared_C_S)
REGION_ALIAS("gfx_mem_sel", gfx_mem_C)
REGION_ALIAS("gfx_mem_sel_S", gfx_mem_C_S)
REGION_ALIAS("m33s_shared_sel", m33s_shared_C)
REGION_ALIAS("m33s_shared_sel_S", m33s_shared_C_S)
REGION_ALIAS("m33s_data_sel", m33s_data_C)
REGION_ALIAS("m33s_data_sel_S", m33s_data_C_S)
REGION_ALIAS("m33_code_sel", m33_code_C)
REGION_ALIAS("m33_code_sel_S", m33_code_C_S)
REGION_ALIAS("m33_data_sel", m33_data_C)
REGION_ALIAS("m33_data_sel_S", m33_data_C_S)
REGION_ALIAS("m33s_allocatable_shared_sel", m33s_allocatable_shared_C)
REGION_ALIAS("m33s_allocatable_shared_sel_S", m33s_allocatable_shared_C_S)
REGION_ALIAS("m33_allocatable_shared_sel", m33_allocatable_shared_C)
REGION_ALIAS("m33_allocatable_shared_sel_S", m33_allocatable_shared_C_S)
REGION_ALIAS("m55_allocatable_shared_sel", m55_allocatable_shared_C)
REGION_ALIAS("m55_allocatable_shared_sel_S", m55_allocatable_shared_C_S)
